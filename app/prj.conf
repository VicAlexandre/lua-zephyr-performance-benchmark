## CMakeLists.txt
```
cmake_minimum_required(VERSION 3.20.0)

set(BENCH_EXP B CACHE STRING "Experiment: CAL, A, B or C")
set(BENCH_MODEL MT CACHE STRING "Model: MT, MC, BASE or NONE")
set(BENCH_N 1 CACHE STRING "Exp. A: replicas of T1, or FULL")
set(BENCH_PAYLOAD 8 CACHE STRING "Exp. B: T4 payload, in bytes")
set(BENCH_SLICE_US 1000 CACHE STRING "Exp. C: slice duration S, in us")
set(BENCH_PRIO EQUAL CACHE STRING "Exp. C, MT: EQUAL or SPLIT")
set(BENCH_HEAP 32768 CACHE STRING "Heap of each Lua state, in bytes")
set(BENCH_DIAG "" CACHE STRING "Diagnostics (list): GC, COLS")

include(${CMAKE_CURRENT_SOURCE_DIR}/../../modules/lang/lua_zephyr/luaz.cmake)
include(cmake/bench.cmake)

list(APPEND EXTRA_CONF_FILE ${CMAKE_CURRENT_SOURCE_DIR}/calibration.conf)

find_package(Zephyr REQUIRED HINTS $ENV{ZEPHYR_BASE})
project(bench)

luaz_add_bytecode_file(lua/tasks.lua)
luaz_generate_threads()

target_include_directories(app PRIVATE src)
target_sources(app PRIVATE
  src/main.c
  src/probe.c
  src/channels.c
  src/stimulus.c
  src/lua_bench.c
  ${BENCH_GEN_DIR}/bench_glue.c
)
target_sources_ifdef(CONFIG_BENCH_MODEL_BASE app PRIVATE src/baseline.c)
```

## Kconfig
```
mainmenu "lua_zephyr concurrency benchmark"

menu "Experiments"

choice BENCH_EXP
	prompt "Experiment"
	default BENCH_EXP_B

config BENCH_EXP_CAL
	bool "Calibration (probe cost and table slot size)"

config BENCH_EXP_A
	bool "Experiment A: footprint"

config BENCH_EXP_B
	bool "Experiment B: dispatch latency"

config BENCH_EXP_C
	bool "Experiment C: cooperative blocking"

endchoice

choice BENCH_MODEL
	prompt "Concurrency model"
	default BENCH_MODEL_MT

config BENCH_MODEL_MT
	bool "MT: one Lua thread per task"

config BENCH_MODEL_MC
	bool "MC: coroutines of one async thread"

config BENCH_MODEL_BASE
	bool "Baseline: C receiver, no Lua"

config BENCH_MODEL_NONE
	bool "Reference: no tasks (fixed part of the footprint)"

endchoice

config BENCH_NTASKS
	int "Number of Lua tasks in the configuration"
	default 0
	help
	  Set by CMake. The generator waits for all of them to signal readiness
	  before the first activation.

config BENCH_MEASURED_TASK
	int "Archetype whose timestamps are recorded (0 = none)"
	default 4 if BENCH_EXP_B || BENCH_EXP_C
	default 0

config BENCH_SEED
	int "Pseudorandom generator seed"
	default 20261103

config BENCH_WARMUP
	int "Warm-up samples (discarded in the analysis)"
	default 100

config BENCH_SAMPLES
	int "Samples collected after the warm-up"
	default 1000

config BENCH_RUN_MS
	int "Duration of a run without timing samples (Experiment A), in ms"
	default 10000

config BENCH_SLICE_US
	int "Experiment C: duration S of each background task slice, in us"
	default 1000

config BENCH_T5_PUBS
	int "T5: back-to-back publications per activation"
	default 10

config BENCH_SLOT_BYTES
	int "Bytes per Lua table slot (calibration)"
	default 8
	help
	  Used to convert M_i into a number of table slots.

config BENCH_GEN_PRIORITY
	int "Stimulus generator thread priority"
	default 2

config BENCH_GEN_STACK_SIZE
	int "Stimulus generator thread stack size"
	default 2048

config BENCH_DIAG_GC
	bool "Diagnostic: record the end of each garbage collector cycle"
	help
	  The measured task keeps a sentinel object with __gc; each collection
	  of it marks the end of a cycle and records the time and the latest
	  activation. Diagnostic only: disabled in the measurements.

config BENCH_DIAG_COLS
	bool "Diagnostic: extra timestamps per activation (generator and work loop)"
	help
	  d0: return of zbus_chan_pub in the generator; d1: generator about to
	  sleep; d2 and d3: start and end of the work loop in the task body.
	  Diagnostic only: disabled in the measurements.

task = T1
sporadic = n
period = 1000
c_us = 500
m_bytes = 64
p_bytes = 8
rsource "Kconfig.task"

task = T2
sporadic = n
period = 10000
c_us = 50000
m_bytes = 4096
p_bytes = 8
rsource "Kconfig.task"

task = T3
sporadic = n
period = 10000
c_us = 5000
m_bytes = 8192
p_bytes = 16
rsource "Kconfig.task"

task = T4
sporadic = y
period = 1000
c_us = 200
m_bytes = 0
p_bytes = 8
rsource "Kconfig.task"

task = T5
sporadic = n
period = 10000
c_us = 0
m_bytes = 2048
p_bytes = 64
rsource "Kconfig.task"

task = T6
sporadic = y
period = 5000
c_us = 500
m_bytes = 256
p_bytes = 32
rsource "Kconfig.task"

endmenu

source "Kconfig.zephyr"
```

## Kconfig.task
```
config BENCH_$(task)_ENABLE
	bool "Archetype $(task) activated by the generator"
	help
	  Enabled by CMake when some task of the archetype exists in the
	  configuration.

config BENCH_$(task)_SPORADIC
	bool
	default $(sporadic)

config BENCH_$(task)_PERIOD_MS
	int "$(task): period (periodic) or minimum interarrival time (sporadic), in ms"
	default $(period)

config BENCH_$(task)_C_US
	int "$(task): computation time C_i, in us"
	default $(c_us)

config BENCH_$(task)_M_BYTES
	int "$(task): memory allocated per instance M_i, in bytes"
	default $(m_bytes)

config BENCH_$(task)_P_BYTES
	int "$(task): payload size P_i, in bytes"
	range 1 1024
	default $(p_bytes)
```

## prj.conf
```kconfig
CONFIG_LUA=y
CONFIG_LUA_LIB_BASE=y
CONFIG_LUA_LIB_ZBUS=y
CONFIG_LUA_PRECOMPILE=y
CONFIG_LUA_PRECOMPILE_ONLY=y

CONFIG_ZBUS_MSG_SUBSCRIBER_NET_BUF_POOL_SIZE=64
CONFIG_HEAP_MEM_POOL_SIZE=16384

CONFIG_SYS_HEAP_RUNTIME_STATS=y

CONFIG_TIMESLICING=y
CONFIG_TIMESLICE_SIZE=20
CONFIG_TIMESLICE_PRIORITY=0

CONFIG_LOG=n
CONFIG_ASSERT=n
CONFIG_PRINTK=y
CONFIG_BOOT_BANNER=n
```

## calibration.conf
```kconfig
CONFIG_BENCH_SLOT_BYTES=5
```

## src/main.c
```c
#include <zephyr/kernel.h>
#include <zephyr/version.h>

int main(void)
{
	printk("#BOOT zephyr=%s board=%s\n", KERNEL_VERSION_STRING, CONFIG_BOARD_TARGET);
	return 0;
}
```

## src/baseline.c
```c
#include <zephyr/kernel.h>
#include <zephyr/zbus/zbus.h>

#include "bench.h"
#include "channels.h"

ZBUS_MSG_SUBSCRIBER_DEFINE(base_sub);
ZBUS_CHAN_ADD_OBS(chan_t4, base_sub, 3);

static void base_thread(void *p1, void *p2, void *p3)
{
	ARG_UNUSED(p1);
	ARG_UNUSED(p2);
	ARG_UNUSED(p3);

	const struct zbus_channel *chan;
	struct bench_act_t4 msg;

	bench_ready();
	while (true) {
		if (zbus_sub_wait_msg(&base_sub, &chan, &msg, K_FOREVER) != 0) {
			continue;
		}
		bench_record(BENCH_T1, 4, msg.seq, bench_cycles());
		bench_busy_us(CONFIG_BENCH_T4_C_US);
		bench_record(BENCH_T2, 4, msg.seq, bench_cycles());
	}
}

K_THREAD_DEFINE(bench_base, 2048, base_thread, NULL, NULL, NULL, CONFIG_LUA_THREAD_PRIORITY, 0, 0);
```

## src/bench.h
```c
#ifndef BENCH_H_
#define BENCH_H_

#include <stdint.h>
#include <zephyr/kernel.h>

#include <cmsis_core.h>

enum bench_point {
	BENCH_T0 = 0,
	BENCH_T1 = 1,
	BENCH_T2 = 2,
};

#define BENCH_TOTAL (CONFIG_BENCH_WARMUP + CONFIG_BENCH_SAMPLES)

static ALWAYS_INLINE uint32_t bench_cycles(void)
{
	return DWT->CYCCNT;
}

uint32_t bench_hz(void);

void bench_record(enum bench_point point, int task, uint32_t seq, uint32_t cycles);

void bench_tick(uint32_t cycles);

uint32_t bench_tick_median(void);

uint32_t bench_probe_cost_c(void);

void bench_busy_us(uint32_t us);

void bench_ready(void);

int bench_wait_ready(k_timeout_t timeout);

void bench_dump(void);

void bench_heap_dump(void);

void bench_diag(int col, int task, uint32_t seq, uint32_t cycles);

void bench_gc_mark(uint32_t cycles);

void bench_gen_dump(void);

#endif
```

## src/channels.c
```c
#include <luaz_msg_descr.h>
#include <zephyr/zbus/zbus.h>

#include "channels.h"

#define ACT_FIELDS(n)                                                                              \
	static const struct lua_msg_field_descr act_t##n##_fields[] = {                            \
		LUA_MSG_FIELD(struct bench_act_t##n, seq, LUA_MSG_TYPE_UINT),                      \
		LUA_MSG_FIELD(struct bench_act_t##n, data, LUA_MSG_TYPE_STRING_BUF),               \
	}

ACT_FIELDS(1);
ACT_FIELDS(2);
ACT_FIELDS(3);
ACT_FIELDS(4);
ACT_FIELDS(5);
ACT_FIELDS(6);

#define ACT_CHAN(n)                                                                                \
	ZBUS_CHAN_DEFINE(chan_t##n, struct bench_act_t##n, NULL,                                   \
			 LUA_ZBUS_MSG_DESCR(struct bench_act_t##n, act_t##n##_fields),             \
			 ZBUS_OBSERVERS_EMPTY, ZBUS_MSG_INIT(0))

ACT_CHAN(1);
ACT_CHAN(2);
ACT_CHAN(3);
ACT_CHAN(4);
ACT_CHAN(5);
ACT_CHAN(6);

static const struct lua_msg_field_descr tlm_fields[] = {
	LUA_MSG_FIELD(struct bench_tlm, seq, LUA_MSG_TYPE_UINT),
	LUA_MSG_FIELD(struct bench_tlm, data, LUA_MSG_TYPE_STRING_BUF),
};

ZBUS_CHAN_DEFINE(chan_tlm, struct bench_tlm, NULL, LUA_ZBUS_MSG_DESCR(struct bench_tlm, tlm_fields),
		 ZBUS_OBSERVERS_EMPTY, ZBUS_MSG_INIT(0));

static const struct lua_msg_field_descr task_cfg_fields[] = {
	LUA_MSG_FIELD(struct bench_task_cfg, period_ms, LUA_MSG_TYPE_INT),
	LUA_MSG_FIELD(struct bench_task_cfg, c_us, LUA_MSG_TYPE_INT),
	LUA_MSG_FIELD(struct bench_task_cfg, m_bytes, LUA_MSG_TYPE_INT),
	LUA_MSG_FIELD(struct bench_task_cfg, p_bytes, LUA_MSG_TYPE_INT),
};

static const struct lua_msg_field_descr cfg_fields[] = {
	LUA_MSG_FIELD_OBJECT(struct bench_cfg, t1, task_cfg_fields),
	LUA_MSG_FIELD_OBJECT(struct bench_cfg, t2, task_cfg_fields),
	LUA_MSG_FIELD_OBJECT(struct bench_cfg, t3, task_cfg_fields),
	LUA_MSG_FIELD_OBJECT(struct bench_cfg, t4, task_cfg_fields),
	LUA_MSG_FIELD_OBJECT(struct bench_cfg, t5, task_cfg_fields),
	LUA_MSG_FIELD_OBJECT(struct bench_cfg, t6, task_cfg_fields),
	LUA_MSG_FIELD(struct bench_cfg, slot_bytes, LUA_MSG_TYPE_INT),
	LUA_MSG_FIELD(struct bench_cfg, slice_us, LUA_MSG_TYPE_INT),
	LUA_MSG_FIELD(struct bench_cfg, t5_pubs, LUA_MSG_TYPE_INT),
	LUA_MSG_FIELD(struct bench_cfg, measured, LUA_MSG_TYPE_INT),
};

#define TASK_CFG(n)                                                                                \
	{                                                                                          \
		.period_ms = CONFIG_BENCH_T##n##_PERIOD_MS, .c_us = CONFIG_BENCH_T##n##_C_US,      \
		.m_bytes = CONFIG_BENCH_T##n##_M_BYTES, .p_bytes = CONFIG_BENCH_T##n##_P_BYTES,    \
	}

ZBUS_CHAN_DEFINE(chan_cfg, struct bench_cfg, NULL, LUA_ZBUS_MSG_DESCR(struct bench_cfg, cfg_fields),
		 ZBUS_OBSERVERS_EMPTY,
		 ZBUS_MSG_INIT(.t1 = TASK_CFG(1), .t2 = TASK_CFG(2), .t3 = TASK_CFG(3),
			       .t4 = TASK_CFG(4), .t5 = TASK_CFG(5), .t6 = TASK_CFG(6),
			       .slot_bytes = CONFIG_BENCH_SLOT_BYTES,
			       .slice_us = CONFIG_BENCH_SLICE_US, .t5_pubs = CONFIG_BENCH_T5_PUBS,
			       .measured = CONFIG_BENCH_MEASURED_TASK));
```

## src/channels.h
```c
#ifndef CHANNELS_H_
#define CHANNELS_H_

#include <stdint.h>
#include <zephyr/zbus/zbus.h>

#define BENCH_ACT_STRUCT(n)                                                                        \
	struct bench_act_t##n {                                                                    \
		uint32_t seq;                                                                      \
		char data[CONFIG_BENCH_T##n##_P_BYTES];                                            \
	}

BENCH_ACT_STRUCT(1);
BENCH_ACT_STRUCT(2);
BENCH_ACT_STRUCT(3);
BENCH_ACT_STRUCT(4);
BENCH_ACT_STRUCT(5);
BENCH_ACT_STRUCT(6);

struct bench_tlm {
	uint32_t seq;
	char data[CONFIG_BENCH_T5_P_BYTES];
};

struct bench_task_cfg {
	int32_t period_ms;
	int32_t c_us;
	int32_t m_bytes;
	int32_t p_bytes;
};

struct bench_cfg {
	struct bench_task_cfg t1, t2, t3, t4, t5, t6;
	int32_t slot_bytes;
	int32_t slice_us;
	int32_t t5_pubs;
	int32_t measured;
};

ZBUS_CHAN_DECLARE(chan_cfg, chan_t1, chan_t2, chan_t3, chan_t4, chan_t5, chan_t6, chan_tlm);

#endif
```

## src/lua_bench.c
```c
#include <lauxlib.h>
#include <lua.h>
#include <zephyr/kernel.h>
#include <zephyr/sys/printk.h>
#include <zephyr/sys/sys_heap.h>

#include "bench.h"
#include "tasks_lua_bytecode.h"

#define MAX_HEAPS 32

struct heap_slot {
	const char *name;
	struct sys_heap *heap;
	lua_Alloc alloc;
	void *ud;
	uint32_t alloc_fail;
};

static struct heap_slot heaps[MAX_HEAPS];
static atomic_t heap_count;

static void *counting_alloc(void *ud, void *ptr, size_t osize, size_t nsize)
{
	struct heap_slot *slot = ud;
	void *res = slot->alloc(slot->ud, ptr, osize, nsize);

	if (res == NULL && nsize > 0) {
		slot->alloc_fail++;
	}
	return res;
}

void bench_heap_dump(void)
{
	size_t n = MIN((size_t)atomic_get(&heap_count), ARRAY_SIZE(heaps));

	for (size_t i = 0; i < n; i++) {
		struct sys_memory_stats st = {0};

		sys_heap_runtime_stats_get(heaps[i].heap, &st);
		printk("#HEAP name=%s size=%zu peak=%zu alloc_fail=%u\n", heaps[i].name,
		       st.free_bytes + st.allocated_bytes, st.max_allocated_bytes,
		       heaps[i].alloc_fail);
	}
}

static int l_t1(lua_State *L)
{
	uint32_t c = bench_cycles();

	bench_record(BENCH_T1, (int)luaL_checkinteger(L, 1), (uint32_t)luaL_checkinteger(L, 2), c);
	return 0;
}

static int l_t2(lua_State *L)
{
	uint32_t c = bench_cycles();

	bench_record(BENCH_T2, (int)luaL_checkinteger(L, 1), (uint32_t)luaL_checkinteger(L, 2), c);
	return 0;
}

static int l_tick(lua_State *L)
{
	ARG_UNUSED(L);
	bench_tick(bench_cycles());
	return 0;
}

static int l_ready(lua_State *L)
{
	ARG_UNUSED(L);
	bench_ready();
	return 0;
}

static int l_cycles(lua_State *L)
{
	lua_pushinteger(L, (lua_Integer)bench_cycles());
	return 1;
}

static int l_elapsed(lua_State *L)
{
	uint32_t a = (uint32_t)luaL_checkinteger(L, 1);
	uint32_t b = (uint32_t)luaL_checkinteger(L, 2);

	lua_pushinteger(L, (lua_Integer)(b - a));
	return 1;
}

static int l_hz(lua_State *L)
{
	lua_pushinteger(L, (lua_Integer)bench_hz());
	return 1;
}

static int l_mark(lua_State *L)
{
	uint32_t c = bench_cycles();

	bench_diag((int)luaL_checkinteger(L, 1), (int)luaL_checkinteger(L, 2),
		   (uint32_t)luaL_checkinteger(L, 3), c);
	return 0;
}

static int l_diag_cols(lua_State *L)
{
	lua_pushboolean(L, IS_ENABLED(CONFIG_BENCH_DIAG_COLS));
	return 1;
}

static int l_gc_mark(lua_State *L)
{
	ARG_UNUSED(L);
	bench_gc_mark(bench_cycles());
	return 0;
}

static int l_diag_gc(lua_State *L)
{
	lua_pushboolean(L, IS_ENABLED(CONFIG_BENCH_DIAG_GC));
	return 1;
}

static int l_dump(lua_State *L)
{
	ARG_UNUSED(L);
	bench_dump();
	return 0;
}

static const luaL_Reg bench_funcs[] = {
	{"t1", l_t1},         {"t2", l_t2},           {"tick", l_tick}, {"ready", l_ready},
	{"cycles", l_cycles}, {"elapsed", l_elapsed}, {"hz", l_hz},     {"dump", l_dump},
	{"gc_mark", l_gc_mark}, {"diag_gc", l_diag_gc}, {"mark", l_mark}, {"diag_cols", l_diag_cols},
	{NULL, NULL},
};

static int open_bench(lua_State *L)
{
	luaL_newlib(L, bench_funcs);
	return 1;
}

static int open_tasks(lua_State *L)
{
	if (luaL_loadbuffer(L, (const char *)tasks_lua_bytecode, tasks_lua_bytecode_len, "tasks") !=
	    LUA_OK) {
		return lua_error(L);
	}
	lua_call(L, 0, 1);
	return 1;
}

int bench_lua_setup(lua_State *L, const char *name)
{
	atomic_val_t i = atomic_inc(&heap_count);

	if (i < ARRAY_SIZE(heaps)) {
		struct heap_slot *slot = &heaps[i];

		slot->name = name;
		slot->alloc = lua_getallocf(L, &slot->ud);
		slot->heap = slot->ud;
		lua_setallocf(L, counting_alloc, slot);
	}

	luaL_getsubtable(L, LUA_REGISTRYINDEX, LUA_PRELOAD_TABLE);
	lua_pushcfunction(L, open_bench);
	lua_setfield(L, -2, "bench");
	lua_pushcfunction(L, open_tasks);
	lua_setfield(L, -2, "tasks");
	lua_pop(L, 1);

	return 0;
}
```

## src/probe.c
```c
#include <zephyr/init.h>
#include <zephyr/kernel.h>
#include <zephyr/sys/printk.h>
#include <zephyr/sys/util.h>

#include "bench.h"

#define TICK_PAIRS 32

static uint32_t samples[3][BENCH_TOTAL];
static uint32_t ticks[2 * TICK_PAIRS];
static atomic_t tick_count;

K_SEM_DEFINE(ready_sem, 0, K_SEM_MAX_LIMIT);

#define GC_MARKS 512
static uint32_t gc_cycles[GC_MARKS];
static uint32_t gc_seq[GC_MARKS];
static atomic_t gc_count;
static uint32_t last_seq = UINT32_MAX;

#ifdef CONFIG_BENCH_DIAG_COLS
static uint32_t diag[4][BENCH_TOTAL];
#endif

void bench_diag(int col, int task, uint32_t seq, uint32_t cycles)
{
#ifdef CONFIG_BENCH_DIAG_COLS
	if (task == CONFIG_BENCH_MEASURED_TASK && seq < BENCH_TOTAL && col >= 0 && col < 4) {
		diag[col][seq] = cycles;
	}
#else
	ARG_UNUSED(col);
	ARG_UNUSED(task);
	ARG_UNUSED(seq);
	ARG_UNUSED(cycles);
#endif
}

static int probe_init(void)
{
	DCB->DEMCR |= DCB_DEMCR_TRCENA_Msk;
	DWT->CYCCNT = 0;
	DWT->CTRL |= DWT_CTRL_CYCCNTENA_Msk;
	return 0;
}

SYS_INIT(probe_init, PRE_KERNEL_1, 0);

uint32_t bench_hz(void)
{
	return sys_clock_hw_cycles_per_sec();
}

void bench_record(enum bench_point point, int task, uint32_t seq, uint32_t cycles)
{
	if (task != CONFIG_BENCH_MEASURED_TASK || seq >= BENCH_TOTAL) {
		return;
	}
	samples[point][seq] = cycles;
	if (point == BENCH_T1) {
		last_seq = seq;
	}
}

void bench_gc_mark(uint32_t cycles)
{
	atomic_val_t i = atomic_inc(&gc_count);

	if (i < GC_MARKS) {
		gc_cycles[i] = cycles;
		gc_seq[i] = last_seq;
	}
}

void bench_tick(uint32_t cycles)
{
	atomic_val_t i = atomic_inc(&tick_count);

	if (i < ARRAY_SIZE(ticks)) {
		ticks[i] = cycles;
	}
}

static uint32_t median(uint32_t *v, size_t n)
{
	for (size_t i = 1; i < n; i++) {
		uint32_t x = v[i];
		size_t j = i;

		while (j > 0 && v[j - 1] > x) {
			v[j] = v[j - 1];
			j--;
		}
		v[j] = x;
	}
	return n ? v[n / 2] : 0;
}

uint32_t bench_tick_median(void)
{
	size_t pairs = MIN((size_t)atomic_get(&tick_count), ARRAY_SIZE(ticks)) / 2;
	uint32_t d[TICK_PAIRS];

	for (size_t i = 0; i < pairs; i++) {
		d[i] = ticks[2 * i + 1] - ticks[2 * i];
	}
	return median(d, pairs);
}

uint32_t bench_probe_cost_c(void)
{
	uint32_t d[TICK_PAIRS];

	for (size_t i = 0; i < ARRAY_SIZE(d); i++) {
		uint32_t a = bench_cycles();
		uint32_t b = bench_cycles();

		d[i] = b - a;
	}
	return median(d, ARRAY_SIZE(d));
}

void bench_busy_us(uint32_t us)
{
	uint32_t start = bench_cycles();
	uint32_t span = (uint32_t)(((uint64_t)us * bench_hz()) / USEC_PER_SEC);

	while (bench_cycles() - start < span) {
	}
}

void bench_ready(void)
{
	k_sem_give(&ready_sem);
}

int bench_wait_ready(k_timeout_t timeout)
{
	for (int i = 0; i < CONFIG_BENCH_NTASKS; i++) {
		int err = k_sem_take(&ready_sem, timeout);

		if (err) {
			return err;
		}
	}
	return 0;
}

static const char *exp_name(void)
{
	return IS_ENABLED(CONFIG_BENCH_EXP_CAL) ? "CAL"
	       : IS_ENABLED(CONFIG_BENCH_EXP_A) ? "A"
	       : IS_ENABLED(CONFIG_BENCH_EXP_B) ? "B"
						: "C";
}

static const char *model_name(void)
{
	return IS_ENABLED(CONFIG_BENCH_MODEL_MT)   ? "MT"
	       : IS_ENABLED(CONFIG_BENCH_MODEL_MC) ? "MC"
	       : IS_ENABLED(CONFIG_BENCH_MODEL_BASE) ? "BASE"
						  : "NONE";
}

void bench_dump(void)
{
	printk("#BENCH exp=%s model=%s ntasks=%d seed=%d warmup=%d samples=%d hz=%u "
	       "payload_t4=%d slice_us=%d slot_bytes=%d\n",
	       exp_name(), model_name(), CONFIG_BENCH_NTASKS, CONFIG_BENCH_SEED,
	       CONFIG_BENCH_WARMUP, CONFIG_BENCH_SAMPLES, bench_hz(), CONFIG_BENCH_T4_P_BYTES,
	       CONFIG_BENCH_SLICE_US, CONFIG_BENCH_SLOT_BYTES);
	printk("#PROBE where=c cycles=%u\n", bench_probe_cost_c());
	if (atomic_get(&tick_count) >= 2) {
		printk("#PROBE where=lua cycles=%u\n", bench_tick_median());
	}
	bench_gen_dump();
	bench_heap_dump();
	for (size_t i = 0; i < MIN((size_t)atomic_get(&gc_count), GC_MARKS); i++) {
		printk("#GC after_seq=%d cycles=%u\n", (int)gc_seq[i], gc_cycles[i]);
	}

	if (CONFIG_BENCH_MEASURED_TASK != 0) {
#ifdef CONFIG_BENCH_DIAG_COLS
		printk("seq,t0,t1,t2,d0,d1,d2,d3\n");
		for (uint32_t i = 0; i < BENCH_TOTAL; i++) {
			printk("%u,%u,%u,%u,%u,%u,%u,%u\n", i, samples[BENCH_T0][i],
			       samples[BENCH_T1][i], samples[BENCH_T2][i], diag[0][i], diag[1][i],
			       diag[2][i], diag[3][i]);
		}
#else
		printk("seq,t0,t1,t2\n");
		for (uint32_t i = 0; i < BENCH_TOTAL; i++) {
			printk("%u,%u,%u,%u\n", i, samples[BENCH_T0][i], samples[BENCH_T1][i],
			       samples[BENCH_T2][i]);
		}
#endif
	}
	printk("#END\n");
}
```

## src/stimulus.c
```c
#include <string.h>

#include <zephyr/kernel.h>
#include <zephyr/sys/printk.h>
#include <zephyr/zbus/zbus.h>

#include "bench.h"
#include "channels.h"

struct gen_task {
	int id;
	const struct zbus_channel *chan;
	void *msg;
	size_t data_len;
	char *data;
	bool enabled;
	bool sporadic;
	uint32_t period_ms;
	uint32_t seq;
	k_ticks_t due;
};

#define GEN_MSG(n) static struct bench_act_t##n msg_t##n

GEN_MSG(1);
GEN_MSG(2);
GEN_MSG(3);
GEN_MSG(4);
GEN_MSG(5);
GEN_MSG(6);

#define GEN_TASK(n)                                                                                \
	{                                                                                          \
		.id = n, .chan = &chan_t##n, .msg = &msg_t##n,                                     \
		.data_len = sizeof(msg_t##n.data), .data = msg_t##n.data,                          \
		.enabled = IS_ENABLED(CONFIG_BENCH_T##n##_ENABLE),                                 \
		.sporadic = IS_ENABLED(CONFIG_BENCH_T##n##_SPORADIC),                              \
		.period_ms = CONFIG_BENCH_T##n##_PERIOD_MS,                                        \
	}

static struct gen_task tasks[] = {GEN_TASK(1), GEN_TASK(2), GEN_TASK(3),
				  GEN_TASK(4), GEN_TASK(5), GEN_TASK(6)};

static uint32_t rng_state = CONFIG_BENCH_SEED;

static struct gen_task *diag_pending;
static uint32_t diag_seq;
static uint32_t pub_errors;

static uint32_t rng_next(void)
{
	uint32_t x = rng_state;

	x ^= x << 13;
	x ^= x >> 17;
	x ^= x << 5;
	rng_state = x;
	return x;
}

static k_ticks_t interval(const struct gen_task *t)
{
	uint64_t min_us = (uint64_t)t->period_ms * USEC_PER_MSEC;

	if (!t->sporadic) {
		return k_us_to_ticks_near64(min_us);
	}
	return k_us_to_ticks_near64(min_us + (rng_next() % min_us));
}

static void publish(struct gen_task *t)
{
	uint32_t seq = t->seq++;

	*(uint32_t *)t->msg = seq;
	bench_record(BENCH_T0, t->id, seq, bench_cycles());
	if (zbus_chan_pub(t->chan, t->msg, K_MSEC(100)) != 0) {
		pub_errors++;
	}
	if (IS_ENABLED(CONFIG_BENCH_DIAG_COLS)) {
		bench_diag(0, t->id, seq, bench_cycles());
		diag_pending = t;
		diag_seq = seq;
	}
}

void bench_gen_dump(void)
{
	printk("#GEN pub_errors=%u", pub_errors);
	for (size_t i = 0; i < ARRAY_SIZE(tasks); i++) {
		if (tasks[i].enabled) {
			printk(" t%d=%u", tasks[i].id, tasks[i].seq);
		}
	}
	printk("\n");
}

static void gen_thread(void *p1, void *p2, void *p3)
{
	ARG_UNUSED(p1);
	ARG_UNUSED(p2);
	ARG_UNUSED(p3);

	if (IS_ENABLED(CONFIG_BENCH_EXP_CAL)) {
		return;
	}

	struct gen_task *measured = NULL;

	for (size_t i = 0; i < ARRAY_SIZE(tasks); i++) {
		struct gen_task *t = &tasks[i];

		memset(t->data, 'x', t->data_len - 1);
		t->data[t->data_len - 1] = '\0';
		if (t->enabled && t->id == CONFIG_BENCH_MEASURED_TASK) {
			measured = t;
		}
	}

	if (bench_wait_ready(K_SECONDS(30)) != 0) {
		printk("#ERROR ready timeout\n");
	}
	k_msleep(100);

	k_ticks_t start = k_uptime_ticks();
	k_ticks_t end = start + k_ms_to_ticks_ceil64(CONFIG_BENCH_RUN_MS);
	bool any = false;

	for (size_t i = 0; i < ARRAY_SIZE(tasks); i++) {
		struct gen_task *t = &tasks[i];

		any |= t->enabled;
		t->due = t->sporadic ? start + interval(t) : start;
	}

	while (any) {
		struct gen_task *next = NULL;

		for (size_t i = 0; i < ARRAY_SIZE(tasks); i++) {
			if (tasks[i].enabled && (next == NULL || tasks[i].due < next->due)) {
				next = &tasks[i];
			}
		}
		if (measured == NULL && next->due >= end) {
			break;
		}

		if (IS_ENABLED(CONFIG_BENCH_DIAG_COLS) && diag_pending != NULL) {
			bench_diag(1, diag_pending->id, diag_seq, bench_cycles());
			diag_pending = NULL;
		}
		k_sleep(K_TIMEOUT_ABS_TICKS(next->due));
		publish(next);
		next->due += interval(next);

		if (measured != NULL && measured->seq >= BENCH_TOTAL) {
			break;
		}
	}
	if (!any) {
		k_msleep(CONFIG_BENCH_RUN_MS);
	}

	k_msleep(MAX(1000, 3 * CONFIG_BENCH_SLICE_US / 1000));
	bench_dump();
}

K_THREAD_DEFINE(bench_gen, CONFIG_BENCH_GEN_STACK_SIZE, gen_thread, NULL, NULL, NULL,
		CONFIG_BENCH_GEN_PRIORITY, 0, 0);
```
